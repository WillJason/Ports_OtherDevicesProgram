#include <reg52.h>
#include <intrins.h>
#define  uint   unsigned int
#define  uchar  unsigned char
sbit rs=P3^5; 			       //1为数据选择，0为指令选择
sbit rw=P3^6;			       //控制读与写
sbit lcden=P3^4;		       //使能端
sbit PSB=P3^2;			       //串并接口方式选择 ，1为并方式，0为串方式
sbit CS1=P3^3;			       //空脚,接1或0都行
sbit RST=P3^7;			       //复位脚，低电平有效
uchar table[]={"国足加油"};
uchar i;
uchar code  image[]={ 
       

0x00,0x00,0x00,0x00,0x00,0x00,0x00,0x00,0x00,0x00,0x00,0x00,0x00,0x00,0x00,0x00,
0x00,0x00,0x00,0x00,0x00,0x00,0x00,0x00,0x00,0x00,0x00,0x00,0x00,0x00,0x00,0x00,
0x00,0x00,0x00,0x00,0x00,0x00,0x00,0x00,0x00,0x00,0x00,0x00,0x00,0x00,0x00,0x00,
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0x00,0x00,0x00,0x00,0x00,0x00,0x00,0x00,0x00,0x00,0x00,0x00,0x00,0x00,0x00,0x00};
void delay(uint z)			   //延时公式Z ms 
{ uint x,y;
   for(x=z;x>0;x--)
     for(y=110;y>0;y--);
}
void delay_us(uchar t)		        //延时公式大约50t us
{ uchar i,j;
     for(i=t;i>0;i--)
        for(j=5;j>0;j--);
}

void  read_lcdbf()
{ uchar temp;
	P0=0xff;
     do
	    { 	lcden=0;
		    rs=0;
	        rw=1;
		    _nop_();
		    lcden=1;
			_nop_();
			temp=P0;	   //读数据须在下降沿读出，读时，要在使能端为高电平时间
			lcden=0;
		}
		while(temp&0x80);
}
void write_com(uchar com)			//写指令
{  
  rs=0;
  rw=0;
  lcden=0;
  P0=com;
  lcden=1;
  delay_us(1);
  lcden=0;
  read_lcdbf();
}
void write_date(uchar date)	       //写数据，都是并口的
 { 	 
   rs=1;
   rw=0;
   lcden=0;
   P0=date;
   lcden=1;
   lcden=0; 
   read_lcdbf();
}
void init()					 //八位软件初始化
{  delay(100);
   RST=1;
   CS1=1; 
   PSB=1;					 //选择并行接口
   write_com(0x30);			 //基本指令操作
   delay_us(4);
   write_com(0x0c);			     //只开显示
   delay_us(4);
   write_com(0x01);			     //清屏指令
   delay(15); 
   write_com(0x06);				 //游标每写完一个字指针就加一
   delay(5); 
   write_com(0x80);	
 }
 /*防止花屏，在画点前应该先清除GDRAM显示，记住水平方向是以字节为单位的，
垂直方向以位为单位，所以一行行清除时，会出错
*/
void  clear_GDRAM()		          
{ uchar	i,j,lcd_x=0x80,lcd_y=0x80,k;
  	write_com(0x34);			            //因启用了GDRAM，所以需开扩展指令
    for(i=0;i<2;i++)
     {    for(j=0;j<32;j++)					//因垂直坐标有32位
	          {	   write_com(lcd_y+j);		//一行行的清除
			       write_com(lcd_x);		//因
				   for(k=0;k<16;k++)		 //水平有16个字节
				      {  write_date(0x00);	 //依次清除它们	，水平方向地址会自动加一
					     delay_us(1);
					  }
			  }
		 lcd_x=0x88;
	 }
     	write_com(0x36);
	    write_com(0x30); 
}
void write_image(uchar *p)
{  uchar	i,j,lcd_x=0x80,lcd_y=0x80,k;
  	write_com(0x34);			            //因启用了GDRAM，所以需开扩展指令
    for(i=0;i<2;i++)
     {    for(j=0;j<32;j++)					//因垂直坐标有32位
	          {	   write_com(lcd_y+j);		//一行行的清除
			       write_com(lcd_x);		//因
				   for(k=0;k<16;k++)		 //水平有16个字节
				      {  write_date(*p++);	 //依次清除它们	，水平方向地址会自动加一
					     delay_us(1);
					  }
			  }
		 lcd_x=0x88;
	 }
     	write_com(0x36);
	    write_com(0x30); 
}
void  lcd_pos(uchar x,uchar y)	  //设定显示位置，在第x行，且在x行的第y个字符显示
{  uchar pos;
    switch (x)
	   { case 1:  x=0x80; break;
	     case 2:  x=0x90; break;
		 case 3:  x=0x88; break;
		 case 4:  x=0x98; break;
	   }
	   pos=x+y ;
	  write_com(pos);
}
void main()
{   init();
    clear_GDRAM();
    write_image(image);
	lcd_pos(4,0);
	for(i=0;i<8;i++)
	   	  write_date(table[i]);
     while(1);
}
