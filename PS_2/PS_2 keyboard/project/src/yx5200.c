/********************************************************************************************
	文件: yx5200.c
	作者: WillJason
	版本：V1.0
	备注：这个文件提供了yx5200芯片的固件库  	   
*********************************************************************************************/
#include "STC12C5A60S2.h"
#include "yx5200.h"
#include "uart.h"
#include "io_config.h"
#include "global.h"

uint8_t yx5200_cmd_buf[10];		                          //yx5200指令Buffer
MUSIC music;							                  //yx5200音乐播放结构体变量

/********************************************************************************************
	函数功能：求和校验
	入口参数：Str变量指针 len变量长度  
	返回参数：无
	函数说明：和校验的思路如下：发送的指令，去掉起始和结束。将中间的6个字节进行累加，最后取反码
	         接收端就将接收到的一帧数据，去掉起始和结束。将中间的数据累加，再加上接收到的校验
	         字节。刚好为0.这样就代表接收到的数据完全正确。
********************************************************************************************/
void do_sum(uint8_t *Str, uint8_t len)
{
    uint16_t xorsum = 0;
    uint8_t i;

    for(i = 0; i < len; i ++)
    {
        xorsum  = xorsum + Str[i];
    }
	xorsum     = 0 - xorsum;
	*(Str + i)   = (uint8_t)(xorsum >> 8);
	*(Str + i + 1) = (uint8_t)(xorsum & 0x00ff);
}

/*******************************************************************************************
	函数功能：串口发送一帧数据
	入口参数：len:要发送的数据长度 
	返回说明：无 
	函数说明：无     
********************************************************************************************/
void send_cmd(uint8_t len)
{
    uint8_t i = 0 ;
    uart1_send_byte(0x7E);   
    for(i = 0; i < len; i ++)    
    {
		uart1_send_byte(yx5200_cmd_buf[i]);
    }
    uart1_send_byte(0xEF) ;  
}

/******************************************************************************************
	函数功能： 串口1向yx5200芯片发送命令[包括控制和查询]
	入口参数： cmd:表示控制指令，请查阅指令表，还包括查询的相关指令	           
	           data:传送的参数
	返回参数： 无
	函数说明： 使用该函数之前，确保串口1已初始化
			   串口1向yx5200芯片发送命令后，需要延时200ms，
			   才可对yx5200芯片再一次操作      
******************************************************************************************/
void send_yx5200_cmd(uint8_t cmd , uint16_t dat)
{
	yx5200_cmd_buf[0] = 0xff;                             //保留字节 
    yx5200_cmd_buf[1] = 0x06;                             //长度
    yx5200_cmd_buf[2] = cmd;                              //控制指令
    yx5200_cmd_buf[3] = 0;                                //不需要反馈
    yx5200_cmd_buf[4] = (uint8_t)(dat >> 8);              //参数高字节
    yx5200_cmd_buf[5] = (uint8_t)(dat);                   //参数低字节
    do_sum(&yx5200_cmd_buf[0],6);                         //获得校验
    send_cmd(8);					                      //发送命令
}

/******************************************************************************************
	函数功能：获得yx5200音乐播放完成状态
	入口参数：无
	返回参数：1:表示播放完毕
	函数说明：函数需要延时函数配合使用
*******************************************************************************************/
uint8_t yx5200_play_finish_statu(void)
{
    uint8_t play_finish_statu = 0;                        //播放状态
	static uint8_t play_finish_conuter = 0;               //播放计数
	if(yx5200_play_busy_port != 0)                    
    {		
		if(play_finish_conuter < 10) { play_finish_conuter++;	}
		else { play_finish_statu = 1;	} 			   
	}
	else 
	{
		if(play_finish_conuter > 0)	{ play_finish_conuter--; }
		else play_finish_statu = 0;				      		
	} 		
	return play_finish_statu;
}
/******************************************************************************************
	函数功能：播放指定的音乐文件
	入口参数：指定的音乐文件
	返回参数：无
	函数说明：函数需要延时函数配合使用
*******************************************************************************************/
void Play_Set_Sound(uint16_t dat)
{  
	music.cmd = 0x0F;			                          //设置音乐播放指令	
	//if(yx5200_play_finish_statu())                      //音乐播放完成状态检查，
	//{
	//	music.statu_flag = 0;  	  		
	//}
	if((music.cmd != 0) && (music.statu_flag != 1))	      //启动新的播放
	{
		send_yx5200_cmd(music.cmd,dat);                   //发送音乐播放指令
		delay_ms(200);							          //需延时200ms
		//music.statu_flag = 1;						      //播放状态标志置1
		while(!yx5200_play_finish_statu()){delay_ms(2);}  //等待播放完成
		//relay_port =~relay_port;						  //调试用
		led_port = ~led_port;						      //led灯状态翻转				
	}
    music.cmd = 0;
	//music.folder_num = 0;
	//delay_ms(1);
}








