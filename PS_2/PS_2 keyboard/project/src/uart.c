/**********************************************************************************
	文件: uart.c
	作者: WillJason
	版本：V1.0
	备注：这个文件提供了串口模块的固件库   	   
***********************************************************************************/
#include "STC12C5A60S2.h"
#include "uart.h"

#define FOSC  11059200           //单片机晶振频率			   
#define BAUD  9600               //串口波特率

bit uart1_busy_flag = 0;         //串口1发送忙标志

/***********************************************************************************
	功能描述：串口1初始化
	入口参数：无
	返回参数：无	
	函数说明：注意晶振为11059200 
************************************************************************************/
void uart1_init(void)
{
    TMOD &= 0x0F;
	TMOD |= 0x20;                    //设定定时器1为8位自动重装方式
	SCON = 0x50;                     //8位数据位, 无奇偶校验				   		
	PCON = 0x00;                    
    TH1 = TL1 = -(FOSC / 12 / 32 / BAUD); 
    TR1     = 1; 			        //定时器1打开
    REN     = 0;			        //串口1接收失能
    ES      = 1;			        //串口1中断使能
	EA      = 1;					//总中断使能
}

/***********************************************************************************
	功能描述：串口1中断处理函数
	入口参数：无
	返回参数：无	
	函数说明：无
************************************************************************************/
void uart1_isr() interrupt 4 using 1
{
    if (RI)
    {
		RI = 0;                  //清零接收中断标志
    }
    if (TI)
    {
        TI = 0;                  //清零发送中断标志
        uart1_busy_flag = 0;     //清零正在发送标志
    }
}
/***********************************************************************************
	功能描述：串口1发送1Byte数据
	入口参数：dat：要发送的数据
	返回参数：无	
	函数说明：无
************************************************************************************/
void uart1_send_byte(uint8_t dat)
{
    while (uart1_busy_flag);    //等待之前的数据发送完成
    ACC = dat;                  //数据传递给ACC,计算奇偶标志位
    uart1_busy_flag = 1;		//置位正在发送标志
    SBUF = dat;                 //数据传递到发送buffer
}







