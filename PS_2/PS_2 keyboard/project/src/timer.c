/********************************************************************************************
	文件: time.c
	作者: WillJason
	版本：V1.0
	备注：这个文件提供了定时器模块的固件库   	   
*********************************************************************************************/
#include "STC12C5A60S2.h"
#include "timer.h"
#include "io_config.h"

uint16_t timer0_10s_counter;                              //定时器0用于10s的计数值
uint16_t timer0_10s_counter2;
uint16_t timer0_30s_counter;                              //定时器0用于30s的计数
uint16_t timer0_30s_counter2;

/*********************************************************************************************
	功能描述： 定时器0初始化函数
	入口参数： 无
	返回参数： 无
	函数说明： 5ms的定时	    
**********************************************************************************************/
void timer0_init(void)   
{					
    AUXR |= 0x80;		                                  //定时器时钟1T模式
	TMOD &= 0xF0;		                                  //设置定时器模式
	TMOD |= 0x01;		                                  //设置定时器模式
    TL0 = 0x18;		                                      //设置定时初值
	TH0 = 0x23;		                                      //设置定时初值
	TF0 = 0;		                                      //清除TF0标志
	TR0 = 0;		                                      //定时器0初始不允许计时	
	ET0 = 1; 			                                  //定时器0中断允许使能
	EA = 1;				                                  //中断总允许使能
	timer0_10s_counter = 0;								  //定时器0用于10s的计数值
	timer0_10s_counter2= 0;
    timer0_30s_counter = 0;                               //定时器0用于30s的计数值
    timer0_30s_counter2= 0;
}
/*********************************************************************************************
	功能描述： 定时器0中断服务函数
	入口参数： 无
	返回参数： 无
	函数说明： 每5ms完成一次中断，执行一次中断服务程序
			   为了防止程序中30s的计时数据和连续10s内输入的计时数据发生混乱，采用两种独立的计数
			   变量，这样对其中一个进行重新计时操作，不会影响到另一个计时操作。
			   	    
*********************************************************************************************/
void tm0_isr() interrupt 1 using 1	 
{
	TL0 = 0x18;	
	TH0 = 0x23;
	/*****************10s计时用代码***********************/
	timer0_10s_counter++;								  //记录5ms的次数
	if(timer0_10s_counter >= 100)							  //达到500ms
	{
		timer0_10s_counter=0;
		timer0_10s_counter2++;							  //记录500ms的次数
		if(timer0_10s_counter2 >= 10)						  //10个500ms达到5s
		{
			timer0_10s_counter2=0;
			//5秒计时完成
			Arrival_5s_10Part++;						  //记录5s的次数
		}
	}
	if(Arrival_5s_10Part >= 2)							  //达到10s
	{
		//relay_port=~relay_port;						  //调试用
		Arrival_5s_10Part=0;
		Arrival_10s_10Part=1;							  //达到10s的标志位
	}
	/*****************30s计时用代码***********************/
	if(allow_30s)
	{
		timer0_30s_counter++;								  //记录5ms的次数
		if(timer0_30s_counter >= 100)							  //达到500ms
		{													  
			timer0_30s_counter=0;
			timer0_30s_counter2++;							  //记录500ms的次数
			if(timer0_30s_counter2 >= 10)						  //达到5s
			{
				timer0_30s_counter2=0;
				//5秒计时完成
				Arrival_5s_30Part++;						  //记录5s的次数
				if(Arrival_5s_30Part >= 2)							  //达到10s
				{
					//relay_port=~relay_port;		                  //调试用
					Arrival_10s_30Part++;									  //记录达到10s的次数
					if(Arrival_10s_30Part >= 3)								  //达到30s
					{
						Arrival_10s_30Part=0;
						Part_30s_State=1;									  //返回1表示计时到达30s
					}
				}
			}
		}	
	}	
 } 
/*********************************************************************************************
	功能描述： 10s计时
	入口参数： 无
	返回参数： 无
	函数说明： 在主程序中通过调用该函数来得到函数的返回值，当返回值为1时，表示10s计时完成	    
**********************************************************************************************/
uint8_t timer0_10s(void)   
{
	if(Arrival_10s_10Part >= 1){TR0=0;Arrival_10s_10Part=0;return 1;}//达到10s时，关闭定时器，返回值为1 relay_port=~relay_port;调试用
	else{return 0;}
}
/*********************************************************************************************
	功能描述： 30s计时
	入口参数： 无
	返回参数： 无
	函数说明： 在主程序中通过调用该函数来得到函数的返回值，当返回值为1时，表示30s计时完成	    
**********************************************************************************************/
uint8_t timer0_30s(void)   
{
	if(Part_30s_State>=1)							  //判断是否达到30s
	{
		//TR0=0;
		Part_30s_State=0;
		timer0_30s_counter=0;
	 	timer0_30s_counter2=0;
	 	Arrival_5s_30Part=0;
	 	Arrival_10s_30Part=0;
		allow_30s=0;
		return 1;									  //返回1表示计时到达30s
	}
	else{return 0;}
	return 0;
}
/*********************************************************************************************
	功能描述： 清除10s计时用的计数值
	入口参数： 无
	返回参数： 无
	函数说明： 清除10s计时用的计数值	    
**********************************************************************************************/
void Clean_Time0_Paramater(void) 
{
	 timer0_10s_counter=0;
	 timer0_10s_counter2=0;
	 Arrival_5s_10Part=0;
	 Arrival_10s_10Part=0;
}

